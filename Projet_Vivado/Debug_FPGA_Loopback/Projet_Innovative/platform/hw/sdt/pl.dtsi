/ {
	amba_pl: amba_pl {
		ranges;
		compatible = "simple-bus";
		#address-cells = <1>;
		#size-cells = <1>;
		firmware-name = "design_1_wrapper.bit.bin";
		clocking0: clocking0 {
			compatible = "xlnx,fclk";
			assigned-clocks = <&clkc 15>;
			assigned-clock-rates = <50000000>;
			#clock-cells = <0>;
			clock-output-names = "fabric_clk";
			clocks = <&clkc 15>;
		};
		axi_uartlite_0: serial@42c00000 {
			compatible = "xlnx,axi-uartlite-2.0" , "xlnx,xps-uartlite-1.00.a";
			xlnx,uartlite-board-interface = "Custom";
			xlnx,s-axi-aclk-freq-hz-d = <50>;
			xlnx,ip-name = "axi_uartlite";
			reg = <0x42c00000 0x10000>;
			xlnx,baudrate = <1200>;
			clocks = <&clkc 15>;
			current-speed = <1200>;
			xlnx,use-parity = <0>;
			xlnx,edk-iptype = "PERIPHERAL";
			xlnx,odd-parity = <0>;
			status = "okay";
			clock-names = "s_axi_aclk";
			xlnx,name = "axi_uartlite_0";
			xlnx,data-bits = <8>;
			xlnx,parity = "No_Parity";
		};
	};
};
